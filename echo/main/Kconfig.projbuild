## echo/main/Kconfig.projbuild
```kconfig
menu "Laboratorio IoT (Gateway)"

    choice LAB_ZIGBEE_ROLE
        prompt "Rol Zigbee del Gateway"
        default LAB_ZIGBEE_COORDINATOR
        help
            El Gateway puede formar la red (coordinador) o unirse a la red
            que ya tenga el Router Zigbee (end device).

            Si eliges End Device tambien debes seleccionar
            Component config > Zigbee > Zigbee End Device.

        config LAB_ZIGBEE_COORDINATOR
            bool "Coordinador (forma la red; el Router se une a este Gateway)"
        config LAB_ZIGBEE_END_DEVICE
            bool "End Device (se une a la red del Router)"
    endchoice

    config LAB_ZIGBEE_CHANNEL
        int "Canal Zigbee primario (11-26)"
        range 11 26
        default 13

    config LAB_ZIGBEE_PAN_ID
        hex "PAN ID del Gateway (solo coordinador)"
        default 0x1A62

    config LAB_THINGSPEAK_URL
        string "URL de actualizacion de ThingSpeak"
        default "http://api.thingspeak.com/update"

    config LAB_THINGSPEAK_API_KEY
        string "Write API Key del canal de ThingSpeak"
        default ""

    config LAB_THINGSPEAK_MIN_INTERVAL_S
        int "Segundos minimos entre publicaciones a ThingSpeak"
        range 15 300
        default 15

    config LAB_DISCORD_NOTIFY_CHANNEL
        string "ID de canal de Discord para notificaciones (vacio = ultimo canal con actividad)"
        default ""

    config LAB_HISTORY_MAX
        int "Eventos que devuelve !historial por defecto"
        range 1 30
        default 15

    config LAB_SNTP_SERVER
        string "Servidor NTP"
        default "pool.ntp.org"

    config LAB_TIMEZONE
        string "Zona horaria POSIX"
        default "CST6"

endmenu
```

## echo/sdkconfig.defaults
```kconfig
CONFIG_PARTITION_TABLE_CUSTOM=y
CONFIG_PARTITION_TABLE_CUSTOM_FILENAME="partitions.csv"

#
# Zigbee (ESP32-C6, radio nativo)
#
CONFIG_ZB_ENABLED=y
CONFIG_ZB_ZCZR=y
CONFIG_ZB_RADIO_NATIVE=y
CONFIG_ESP_COEX_SW_COEXIST_ENABLE=y
CONFIG_IEEE802154_ENABLED=y

#
# mbedTLS requerido por el stack Zigbee
#
CONFIG_MBEDTLS_HARDWARE_AES=n
CONFIG_MBEDTLS_HARDWARE_MPI=n
CONFIG_MBEDTLS_HARDWARE_SHA=n
CONFIG_MBEDTLS_CMAC_C=y
CONFIG_MBEDTLS_SSL_PROTO_DTLS=y
CONFIG_MBEDTLS_KEY_EXCHANGE_ECJPAKE=y
CONFIG_MBEDTLS_ECJPAKE_C=y
CONFIG_ESP_SYSTEM_EVENT_TASK_STACK_SIZE=4096

#
# Gateway del laboratorio
#
CONFIG_LAB_ZIGBEE_COORDINATOR=y
CONFIG_LAB_ZIGBEE_CHANNEL=13
CONFIG_LAB_ZIGBEE_PAN_ID=0x1A62
CONFIG_LAB_THINGSPEAK_URL="http://api.thingspeak.com/update"
CONFIG_LAB_THINGSPEAK_API_KEY=""
CONFIG_LAB_THINGSPEAK_MIN_INTERVAL_S=15
CONFIG_LAB_DISCORD_NOTIFY_CHANNEL=""
CONFIG_LAB_HISTORY_MAX=15
CONFIG_LAB_SNTP_SERVER="pool.ntp.org"
CONFIG_LAB_TIMEZONE="CST6"
```

## sdkconfig.defaults
```kconfig
CONFIG_IDF_TARGET="esp32c6"

CONFIG_PARTITION_TABLE_CUSTOM=y
CONFIG_PARTITION_TABLE_CUSTOM_FILENAME="partitions.csv"
CONFIG_PARTITION_TABLE_FILENAME="partitions.csv"
CONFIG_PARTITION_TABLE_OFFSET=0x8000
CONFIG_PARTITION_TABLE_MD5=y

CONFIG_ZB_ENABLED=y
CONFIG_ZB_ZED=y
CONFIG_ZB_RADIO_NATIVE=y
CONFIG_IEEE802154_ENABLED=y
```
