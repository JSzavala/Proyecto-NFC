## zigbee_router/sdkconfig.defaults
```kconfig
CONFIG_IDF_TARGET="esp32c6"

# Partition Table
CONFIG_PARTITION_TABLE_CUSTOM=y
CONFIG_PARTITION_TABLE_CUSTOM_FILENAME="partitions.csv"
CONFIG_PARTITION_TABLE_FILENAME="partitions.csv"

# Zigbee Configuration (Router Role)
CONFIG_ZB_ENABLED=y
CONFIG_ZB_ZCZR=y
CONFIG_ZB_RADIO_NATIVE=y

# Flash size (4MB standard for ESP32-C6)
CONFIG_ESPTOOLPY_FLASHSIZE_4MB=y
```
